#include "motor.h"
#include <Wire.h>
///////////////////////////////////////////////////////////
//Подключаю функции HMC5883L
#include "compas.h"
// Подключаем библиотеку для создания дополнительных последовательных (Serial) портов.
#include <SoftwareSerial.h>
// Подключаем библиотеку управления сервомоторами.
#include <Servo.h>
// Подключаем библиотеку управляющую дальномером.
#include <Ultrasonic.h>
// Подключаем библиотеку управляющую дальномером.
#include "sonar.h"

// Создаем сервомотор поворта головы.
Servo neck;
// Константы - постоянные значения для уточнения углов.
const int left_ang = 168;
const int front_ang = 98;
const int right_ang = 28;
// Временные константы служат для точного задания времени на поворот, разворот, движение вперед
// в миллисекундах.
const int time_90 = 390;
const int time_180 = 750;
const int time_10cm = 220;

void setup()
{
  // Инициализируем дальномер Trig = 13, Echo = 12.
  Sonar_init(13, 12);
  // Инициализируем сервомотор, управление 9 портом.
  neck.attach(14);
  // Переменные – номера контактов (пинов) Arduino.
  // Для левых и правых моторов машинки.
  setup_motor_system(2, 3, 5, 4);
  _stop(); //Двигатели остановлены.

  Wire.begin();
  //Компас
  compas_setup();      // инициализация HMC5883L
  // Устанавливаем скорость передачи данных по кабелю.
  // Порт компьютера
  Serial.begin(9600);
}
// Основная программа.
void loop()
{
  // Создаем переменные для хранения трех дистанций - слева, впереди, справа.
  int Dist_left, Dist_front, Dist_right;
  float Compass_ang;

  _stop();
  Compass_ang = get_Compass_ang();
  while ((Compass_ang > 5) && (Compass_ang < 355))
  {
    if (Compass_ang <= 180)
    {
      left(); //Влево.
    }
    else
    {
      right();//Вправо.
    }
    delay(50);
    _stop();
    delay(10);
    Compass_ang = get_Compass_ang();
  }
  // Анализ обстановки на наличие препятствий.
  // Поворот головы налево.
  neck.write(left_ang);
  // Ждет, так как поворот занимает небольшое время.
  delay(150);
  // Записывает расстояние до препятствия слева.
  Dist_left = Sonar(40);
  // Поворачивает голову прямо вперед.
  neck.write(front_ang);
  // Ждет, так как поворот занимает небольшое время.
  delay(150);
  // Записывает расстояние до препятствия впереди.
  Dist_front = Sonar(40);
  // Поворачивает голову направо.
  neck.write(right_ang);
  // Ждет, так как поворот занимает небольшое время.
  delay(150);
  // Записывает расстояние до препятствия справа.
  Dist_right = Sonar(40);
  neck.write(left_ang);
  if (Dist_front > 20) {
    forward(); // едеn вперед.
  }
  else if ((Dist_left > 20) || (Dist_right > 20))
  {
    if (Dist_left > Dist_right)
    {
      left(); // поворачиваем налево 0,5 секунд.
      delay(time_90);
    }
    else
    {
      right(); // поворачиваем направо 0,5 секунд.
      delay(time_90);
      forward(); // едем вперед 0.5 секунды.
      delay(time_10cm * 2);
    }
  }
  else //Заехал в тупик.
  {
    backward();
    delay(time_10cm);
    _stop();
    neck.write(left_ang);
    // Ждет, так как поворот занимает небольшое время.
    delay(150);
    // Записывает расстояние до препятствия слева.
    Dist_left = Sonar(40);
    // Поворачивает голову направо.
    neck.write(right_ang);
    // Ждет, так как поворот занимает небольшое время.
    delay(200);
    // Записывает расстояние до препятствия справа.
    Dist_right = Sonar(40);
  }
}




